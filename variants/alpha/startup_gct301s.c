/* Generated by startup_generator */

#include <gct301s.h>
#include <core_cm0.h>

extern void _estack(void);  // to force type checking
void Reset_Handler(void);
void default_handler (void) 
{
  while(1);
}

void __attribute__ ((weak)) __libc_init_array (void){}

// Linker supplied pointers

extern unsigned long _sidata;
extern unsigned long _sdata;
extern unsigned long _edata;
extern unsigned long _sbss;
extern unsigned long _ebss;

extern int main(void);

void Reset_Handler(void) {

   unsigned long *src, *dst;

   src = &_sidata;
   dst = &_sdata;

   // Copy data initializers

    while (dst < &_edata)
      *(dst++) = *(src++);

   // Zero bss

   dst = &_sbss;
   while (dst < &_ebss)
       *(dst++) = 0;

  SystemInit();
  __libc_init_array();
  main();
  while(1) {}
}

/* Vector Table */

void NMI_Handler (void) __attribute__ ((weak,  alias ("default_handler")));
void HardFault_Handler (void) __attribute__ ((weak,  alias ("default_handler")));
void SVC_Handler (void) __attribute__ ((weak,  alias ("default_handler")));
void PendSV_Handler (void) __attribute__ ((weak,  alias ("default_handler")));
void SysTick_Handler (void) __attribute__ ((weak,  alias ("default_handler")));

void WDT_Handler (void) __attribute__ ((weak,  alias ("default_handler")));
void RTC_Handler (void) __attribute__ ((weak,  alias ("default_handler")));
void UART0_Handler (void) __attribute__ ((weak,  alias ("default_handler")));
void UART1_Handler (void) __attribute__ ((weak,  alias ("default_handler")));
void UART2_Handler (void) __attribute__ ((weak,  alias ("default_handler")));
void UART3_Handler (void) __attribute__ ((weak,  alias ("default_handler")));
void UART4_Handler (void) __attribute__ ((weak,  alias ("default_handler")));
void UART5_Handler (void) __attribute__ ((weak,  alias ("default_handler")));
void SPI_Handler (void) __attribute__ ((weak,  alias ("default_handler")));
void CFLASH_Handler (void) __attribute__ ((weak,  alias ("default_handler")));
void DFLASH_Handler (void) __attribute__ ((weak,  alias ("default_handler")));
void TIMER0_Handler (void) __attribute__ ((weak,  alias ("default_handler")));
void TIMER1_Handler (void) __attribute__ ((weak,  alias ("default_handler")));
void TIMER2_Handler (void) __attribute__ ((weak,  alias ("default_handler")));
void TIMER3_Handler (void) __attribute__ ((weak,  alias ("default_handler")));
void TIMER4_Handler (void) __attribute__ ((weak,  alias ("default_handler")));
void EXT0_Handler (void) __attribute__ ((weak,  alias ("default_handler")));
void EXT1_Handler (void) __attribute__ ((weak,  alias ("default_handler")));
void EXT2_Handler (void) __attribute__ ((weak,  alias ("default_handler")));
void EXT3_Handler (void) __attribute__ ((weak,  alias ("default_handler")));
void LCD_Handler (void) __attribute__ ((weak,  alias ("default_handler")));
void ADC_Handler (void) __attribute__ ((weak,  alias ("default_handler")));
void GPIOA_Handler (void) __attribute__ ((weak,  alias ("default_handler")));
void GPIOB_Handler (void) __attribute__ ((weak,  alias ("default_handler")));
void GPIOC_Handler (void) __attribute__ ((weak,  alias ("default_handler")));

__attribute__ ((section(".isr_vector")))

void (* const g_pfnVectors[])(void) = {
	_estack,
	Reset_Handler,
	NMI_Handler,
	HardFault_Handler,
  0, 0, 0, 0, 0, 0, 0,
	SVC_Handler,
	0, 0,
	PendSV_Handler,
	SysTick_Handler,
	0,
	WDT_Handler,
	RTC_Handler,
  UART0_Handler,
  UART1_Handler,
  UART2_Handler,
  UART3_Handler,
  UART4_Handler,
  UART5_Handler,
  SPI_Handler,
	CFLASH_Handler,
	DFLASH_Handler,
	TIMER0_Handler,
	TIMER1_Handler,
	TIMER2_Handler,
	TIMER3_Handler,
	TIMER4_Handler,
	EXT0_Handler,
	EXT1_Handler,
	EXT2_Handler,
	EXT3_Handler,
	LCD_Handler,
  ADC_Handler,
  GPIOA_Handler,
  GPIOB_Handler,
  GPIOC_Handler,
  0, 0, 0, 0, 0, 0
};
